/*****************************************************************************
51增加系列单片机通过串口控制舵机控制板例程 
晶振：12M
波特率：9600
作者:Yayi                                       
*****************************************************************************/

#include <STC12C5A60S2.h>
#include <string.h>		 

/*****************************************************************************
1MS延迟函数
/****************************************************************************/
void DELAY_MS (unsigned int a)
{
	unsigned int i;
	while( a-- != 0)
	{
		for(i = 0; i < 600; i++);
	}
}

/*****************************************************************************
UART初始化
*****************************************************************************/
void UART_Init (void)
{
	PCON|=0x80;
	SCON= 0x50;
	AUXR|=0x04;
	BRT=0xb2;
	AUXR|=0x01;
	AUXR|=0x10;
}

/*****************************************************************************
单字符发送函数
/****************************************************************************/
void Send (unsigned char UART_data)		
{ 		
	SBUF = UART_data;		
	while(TI == 0);			
	TI = 0;					 
}

/*****************************************************************************
字符串发送函数
/****************************************************************************/
void Send_All(unsigned char *str)
{
	while(*str != '\0')
	{
		Send(*str);
		*str=*str++;
	}
	*str = 0;
}

/*****************************************************************************
主函数
*****************************************************************************/
void main (void)
{
	UART_Init();			
	while(1)
	{
		Send_All("#3P500T2000\r\n");//控制舵机3至500，速度为2秒完成
		DELAY_MS(2000);//等待2秒，等待舵机执行完成
		Send_All("#3P1500T2000\r\n");//控制舵机3至1500，速度为2秒完成	
		DELAY_MS(3000);//等待2秒，等待舵机执行完成。并且执行完成后再等待1秒。
		Send_All("#3P2500T2000\r\n");	
		DELAY_MS(2000);
		Send_All("#3P1500T2000\r\n");
		DELAY_MS(2000);
	}
}