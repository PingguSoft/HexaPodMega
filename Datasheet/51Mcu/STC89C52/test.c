/*****************************************************************************
51增加系列单片机通过串口控制舵机控制板例程 
晶振：11.05926
波特率：9600
作者:Yayi                                       
*****************************************************************************/
#include <reg52.h>

/*****************************************************************************
UART初始化
*****************************************************************************/
void Uart_Init(void)		
{
	SCON = 0x50;			 
	TMOD = 0x20;			    
	TH1 = 0xFD;				   
	TL1 = 0xfd;
	TR1 = 1;		           
}

/*****************************************************************************
单字符发送函数
/****************************************************************************/
void Send_Char (unsigned char UART_data)		
{ 		
	SBUF = UART_data;			
	while(TI == 0);			
	TI = 0;					  
}

/*****************************************************************************
字符串发送函数
/****************************************************************************/
void Send_String(unsigned char *str)		
{
	while(*str != '\0')		
	{
		Send_Char(*str);			
		*str=*str++;		
	}
	*str = 0;				  
}

/*****************************************************************************
主函数
*****************************************************************************/
void main(void)
{
	Uart_Init();
	Send_String("#1P2000T3000\r\n");
	while(1)
	{

	}
}